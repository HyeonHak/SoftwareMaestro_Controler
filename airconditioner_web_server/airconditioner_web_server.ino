#include <avr/pgmspace.h>

#include "WiFiEsp.h"
#include <IRremote.h>
// Emulate Serial1 on pins 6/7 if not present
#ifndef HAVE_HWSERIAL1
#include "SoftwareSerial.h"

#endif

char ssid[] = "pleasebreath";            // your network SSID (name)
char pass[] = "tnawhatnlwk1";       // your network password
int status = WL_IDLE_STATUS;     // the Wifi radio's status
int reqCount = 0;                // number of requests received

WiFiEspServer server(3000);

IRsend irsend;
unsigned int SEND_IR[227];
unsigned int power[227] = {3200,1550, 500,1150, 500,1150, 500,350, 500,250, 550,350, 500,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300, 500};  // PANASONIC C4D3:64800024
unsigned int power_off[227] = {3150,1550, 500,1150, 500,1150, 500,350, 500,300, 500,350, 500,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300, 500};  // PANASONIC C4D3:64800004

// 운전선택
//냉방, 난방, 제습, 송풍
const unsigned int PROGMEM Mode[4][227] = 
{
  {3100,1550, 500,1150, 500,1150, 500,300, 500,350, 500,350, 450,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350, 500},
  {3100,1550, 500,1150, 500,1150, 550,250, 550,300, 550,250, 550,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1150, 500},
{3100,1550, 500,1150, 500,1150, 550,300, 500,300, 550,300, 500,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350, 450},
{3050,1600, 500,1150, 500,1150, 500,300, 550,300, 500,350, 500,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1200, 500}
};



// 바람세기 1 2 3 자동 (난방기준 - 냉방도 확인해봐야함)
const unsigned int PROGMEM warmspeed[4][227] = 
{{3150,1550, 500,1150, 500,1150, 500,300, 500,350, 500,300, 550,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300, 500},  // PANASONIC C4D3:64800024
{3100,1550, 550,1100, 550,1100, 550,300, 500,300, 550,250, 550,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350, 500},  // PANASONIC C4D3:64800024
{3100,1550, 500,1150, 500,1150, 500,350, 500,300, 550,250, 550,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300, 500},  // PANASONIC C4D3:64800024
{3100,1550, 550,1100, 550,1100, 550,300, 500,300, 550,300, 500,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350, 500}  // PANASONIC C4D3:64800024
};

const unsigned int PROGMEM coldspeed[4][227] = 
{
{3100,1600, 500,1150, 500,1150, 500,350, 500,300, 500,300, 550,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350, 500},  // PANASONIC C4D3:64800024
{3100,1600, 500,1150, 500,1150, 500,300, 500,350, 500,350, 450,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350, 500},  // PANASONIC C4D3:64800024
{3100,1550, 500,1150, 500,1150, 550,300, 500,300, 550,300, 500,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300, 500},  // PANASONIC C4D3:64800024
{3100,1550, 550,1150, 500,1150, 500,300, 500,350, 450,350, 500,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300, 500}  // PANASONIC C4D3:64800024
};

const unsigned int PROGMEM windspeed[4][227] = 
{
  {3050,1600, 450,1200, 450,1200, 500,350, 450,350, 500,350, 450,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400, 450},  // PANASONIC C4D3:64800024
  {3100,1600, 450,1200, 450,1200, 450,350, 450,400, 450,350, 500,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400, 450},  // PANASONIC C4D3:64800024
  {3100,1550, 450,1200, 450,1200, 500,350, 500,300, 500,350, 500,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300, 500}  // PANASONIC C4D3:64800024
};


//냉풍기 온도조절 18~32
const PROGMEM unsigned int coldtemp[15][227] =
{{3050,1600, 450,1200, 550,1100, 550,300, 450,400, 500,250, 500,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1150, 500},
{3150,1550, 500,1150, 550,1100, 500,350, 500,250, 550,300, 550,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1200, 500},
{3100,1550, 500,1150, 550,1100, 550,300, 500,350, 500,300, 500,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1150, 550},
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{3150,1550, 500,1150, 500,1150, 500,350, 500,300, 500,350, 500,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350, 500}
};


//온풍기 온도조절 13~23도
const PROGMEM unsigned int warmtemp[11][227] =
{{3100,1550, 550,1100, 550,1100, 550,300, 500,250, 600,250, 550,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350, 450},
{3100,1550, 550,1100, 550,1100, 550,300, 500,300, 550,300, 500,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350, 450},
{3150,1550, 500,1150, 500,1150, 500,350, 500,300, 500,350, 500,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300, 550},
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{3100,1550, 550,1100, 550,1100, 550,300, 500,300, 550,300, 500,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250, 550}};  // PANASONIC C4D3:64800024


void setup()
{
  // initialize serial for debugging
  Serial.begin(9600);
  // initialize serial for ESP module
  Serial3.begin(9600);
  // initialize ESP module
  WiFi.init(&Serial3);
  if (WiFi.status() == WL_NO_SHIELD) {
    while (true);
  }

  while ( status != WL_CONNECTED) {
    status = WiFi.begin(ssid, pass);
  }
  server.begin();
  IPAddress ip = WiFi.localIP();
  Serial.print("IP Address: ");
  Serial.println(ip);
}


void loop()
{
  // listen for incoming clients
  WiFiEspClient client = server.available();
  
  if (client) {
    bool Data = false;
    String Send_ir;
    boolean currentLineIsBlank = true;
    while (client.connected()) {
      if (client.available()) {
        char c = client.read();
        //Serial.write(c);
        if (c == '\n' && currentLineIsBlank) {
          break;
        }
        if (c == '\n') {
          // you're starting a new line
          currentLineIsBlank = true;
          
        }
        else if (c != '\r') {
          // you've gotten a character on the current line
          currentLineIsBlank = false;
        }
        
        if(c == '?' && !Data){
          Data = true;
        }
        else if(c == ' ' && Data){
          Data = false;
        }
        else if(Data){
          Send_ir+=c;
        }
        
      } 
    }
    delay(500);

          
    client.stop();

    Send_ir+='&';
    //power 켜는 ir 끄는 ir 다름
    
    while(Send_ir.length()!=0)               // 자른 문자열이 나오지 않을 때까지 반복
    {
      Serial.println(Send_ir);
      int found=Send_ir.indexOf('&');
      String substr = Send_ir.substring(0,found);
      
      Serial.println(substr);
      if(substr.equals("power")==1)
      {
         irsend.sendRaw(power, sizeof(power) / sizeof(power[0]),38);
      }
      if(substr.equals("poweroff")==1)
      {
         irsend.sendRaw(power_off, sizeof(power_off) / sizeof(power_off[0]),38);
      }

      else if(substr.equals("cold")==1)
      {
        for(int k=0;k<227;k++)
          SEND_IR[k] = pgm_read_word_near(Mode[0] + k);
        irsend.sendRaw(SEND_IR, sizeof(SEND_IR) / sizeof(SEND_IR[0]),38);
      }
      
      else if(substr.equals("warm")==1)
      {
        for(int k=0;k<227;k++)
          SEND_IR[k] = pgm_read_word_near(Mode[1] + k);
        irsend.sendRaw(SEND_IR, sizeof(SEND_IR) / sizeof(SEND_IR[0]),38);
      }
      else if(substr.equals("dehumidify")==1)
      {
        for(int k=0;k<227;k++)
          SEND_IR[k] = pgm_read_word_near(Mode[2] + k);
        irsend.sendRaw(SEND_IR, sizeof(SEND_IR) / sizeof(SEND_IR[0]),38);
      }
      
      else if(substr.equals("wind")==1)
      {
        for(int k=0;k<227;k++)
          SEND_IR[k] = pgm_read_word_near(Mode[3] + k);
        irsend.sendRaw(SEND_IR, sizeof(SEND_IR) / sizeof(SEND_IR[0]),38);
      }

      
      else if(substr.equals("wspeed1")==1)
      {
        for(int k=0;k<227;k++)
          SEND_IR[k] = pgm_read_word_near(warmspeed[0] + k);
        irsend.sendRaw(SEND_IR, sizeof(SEND_IR) / sizeof(SEND_IR[0]),38);
      }
      else if(substr.equals("wspeed2")==1)
      {
        for(int k=0;k<227;k++)
          SEND_IR[k] = pgm_read_word_near(warmspeed[1] + k);
        irsend.sendRaw(SEND_IR, sizeof(SEND_IR) / sizeof(SEND_IR[0]),38);
      }
      else if(substr.equals("wspeed3")==1)
      {
        for(int k=0;k<227;k++)
          SEND_IR[k] = pgm_read_word_near(warmspeed[2] + k);
        irsend.sendRaw(SEND_IR, sizeof(SEND_IR) / sizeof(SEND_IR[0]),38);
      }
      else if(substr.equals("wspeed4")==1)
      {
        for(int k=0;k<227;k++)
          SEND_IR[k] = pgm_read_word_near(warmspeed[3] + k);
        irsend.sendRaw(SEND_IR, sizeof(SEND_IR) / sizeof(SEND_IR[0]),38);
      }


      else if(substr.equals("cspeed1")==1)
      {
        for(int k=0;k<227;k++)
          SEND_IR[k] = pgm_read_word_near(coldspeed[0] + k);
        irsend.sendRaw(SEND_IR, sizeof(SEND_IR) / sizeof(SEND_IR[0]),38);
      }
      else if(substr.equals("cspeed2")==1)
      {
        for(int k=0;k<227;k++)
          SEND_IR[k] = pgm_read_word_near(coldspeed[1] + k);
        irsend.sendRaw(SEND_IR, sizeof(SEND_IR) / sizeof(SEND_IR[0]),38);
      }
      else if(substr.equals("cspeed3")==1)
      {
        for(int k=0;k<227;k++)
          SEND_IR[k] = pgm_read_word_near(coldspeed[2] + k);
        irsend.sendRaw(SEND_IR, sizeof(SEND_IR) / sizeof(SEND_IR[0]),38);
      }
      else if(substr.equals("cspeed4")==1)
      {
        for(int k=0;k<227;k++)
          SEND_IR[k] = pgm_read_word_near(coldspeed[3] + k);
        irsend.sendRaw(SEND_IR, sizeof(SEND_IR) / sizeof(SEND_IR[0]),38);
      }



      else if(substr.equals("sspeed1")==1)
      {
        for(int k=0;k<227;k++)
          SEND_IR[k] = pgm_read_word_near(windspeed[0] + k);
        irsend.sendRaw(SEND_IR, sizeof(SEND_IR) / sizeof(SEND_IR[0]),38);
      }
      else if(substr.equals("sspeed2")==1)
      {
        for(int k=0;k<227;k++)
          SEND_IR[k] = pgm_read_word_near(windspeed[1] + k);
        irsend.sendRaw(SEND_IR, sizeof(SEND_IR) / sizeof(SEND_IR[0]),38);
      }
      else if(substr.equals("sspeed3")==1)
      {
        for(int k=0;k<227;k++)
          SEND_IR[k] = pgm_read_word_near(windspeed[2] + k);
        irsend.sendRaw(SEND_IR, sizeof(SEND_IR) / sizeof(SEND_IR[0]),38);
      }
     

      else{
        String change_mode = substr.substring(0,4);
        Serial.println(change_mode);
        int Temp;
        if(change_mode == "cold"){
          Temp = substr.substring(4).toInt();
          for(int k=0;k<227;k++)
            SEND_IR[k] = pgm_read_word_near(coldtemp[Temp-18] + k);
          irsend.sendRaw(SEND_IR, sizeof(SEND_IR) / sizeof(SEND_IR[0]),38);
        }
        
        else if(change_mode == "warm"){
          Temp = substr.substring(4).toInt();
          for(int k=0;k<227;k++)
            SEND_IR[k] = pgm_read_word_near(warmtemp[Temp-13] + k);
          irsend.sendRaw(SEND_IR, sizeof(SEND_IR) / sizeof(SEND_IR[0]),38);
        }

        
      }

      Send_ir.remove(0,found+1);
        delay(40);
    }
  }
}
